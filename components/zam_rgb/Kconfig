## components/zam_rgb/Kconfig
```kconfig
menu "ZamproLab RGB indicator"
config ZAM_RGB_VERIFIED_S3
    bool "Enable RGB on verified ESP32-S3 board (GPIO48)"
    depends on IDF_TARGET_ESP32S3
    default n
    help
        Enable only on the verified board with a GRB WS2812-compatible LED on GPIO48.
endmenu
```

## components/zam_runtime_lua/Kconfig
```kconfig
menu "ZamproLab Lua experimental runtime"
config ZAM_LUA_PSRAM_EXPERIMENT
    bool "Experimental Lua allocations in PSRAM"
    depends on IDF_TARGET_ESP32S3 && SPIRAM_USE_CAPS_ALLOC && ZAM_RGB_VERIFIED_S3
    default n
    help
        Phase B experiment for the verified S3 RGB profile only. Lua VM
        allocations require external 8-bit PSRAM and never fall back.
config ZAM_LUA_HEAP_LIMIT
    int "Lua VM allocation limit (bytes)"
    range 16384 262144 if ZAM_LUA_PSRAM_EXPERIMENT
    range 16384 131072 if !ZAM_LUA_PSRAM_EXPERIMENT
    default 49152
    help
        Limit applies only to allocations accounted to the Lua VM.
config ZAM_LUA_SOURCE_LIMIT
    int "Maximum source snapshot (bytes)"
    range 1024 65536
    default 32768
endmenu
```
